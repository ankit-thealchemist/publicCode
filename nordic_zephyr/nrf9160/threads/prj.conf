## CMakeLists.txt
```
# SPDX-License-Identifier: Apache-2.0

cmake_minimum_required(VERSION 3.20.0)

find_package(Zephyr REQUIRED HINTS $ENV{ZEPHYR_BASE})
project(threads)

target_sources(app PRIVATE src/main.c)
```

## prj.conf
```kconfig
# nothing here
CONFIG_LOG=y
CONFIG_SYS_CLOCK_HW_CYCLES_PER_SEC=25000000
CONFIG_FLASH_SIZE=4096
CONFIG_FLASH_BASE_ADDRESS=0x500000
CONFIG_SYS_CLOCK_TICKS_PER_SEC=100
CONFIG_SERIAL_INIT_PRIORITY=50
CONFIG_RESET_ON_FATAL_ERROR=n
CONFIG_GEN_ISR_TABLES=n
CONFIG_IDLE_STACK_SIZE=320
CONFIG_SCHED_SCALABLE=y
CONFIG_WAITQ_SCALABLE=y
CONFIG_XIP=n
CONFIG_DEBUG_INFO=y
CONFIG_LOG_INFO_COLOR_GREEN=y
CONFIG_LOG_OUTPUT_FORMAT_LINUX_TIMESTAMP=y
CONFIG_TEST_RANDOM_GENERATOR=y
CONFIG_COVERAGE_GCOV_HEAP_SIZE=32768
CONFIG_BUILD_OUTPUT_BIN=n
```

## src/main.c
```c
/*
 * Copyright (c) 2012-2014 Wind River Systems, Inc.
 *
 * SPDX-License-Identifier: Apache-2.0
 */

#include <zephyr/kernel.h>
#include <zephyr/logging/log.h>


LOG_MODULE_REGISTER(main,LOG_LEVEL_INF);

#define MY_STACK_SIZE 500
#define MID_PRIORITY 5

void blinky(void *,void*,void*)
{
	printk("I am thread ! %s\n", CONFIG_BOARD);
	
	return;
}

K_THREAD_DEFINE(blinkThread, MY_STACK_SIZE,
                blinky, NULL, NULL, NULL,
                MID_PRIORITY, 0, -1);  // waithing for the infinitite amounnt of time 


void main(void)
{
	printk("Hello World! %s\n", CONFIG_BOARD);
	printk("I am great Ankit Bansal\r\n");

	// k_msleep(5 * 1000);

	// k_thread_start(blinkThread);
	static uint32_t factorial = 1;
	for(uint8_t index =1;index <=10;index ++)
	{
		factorial = factorial * index;
	}

	printk("Factorial is %d\r\n", factorial);

	LOG_ERR("I am error");
	LOG_WRN("I am warn");
	LOG_INF("I am info");
	LOG_DBG("I am debug");
}
```
